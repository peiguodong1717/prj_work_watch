#include "myui.h"
#include "gt21l.h"
#include "string.h"
#include "delay.h"
#include "tm1650.h"


uint8_t Contrast = 0x1f;//对比度
uint8_t logo[]={
0xFF,0xFF,0xFF,0xFF,0xFF,0xFF,0xFF,0xFF,0xFF,0xFF,0xFF,0xFF,0xFF,0xFF,0xFF,0xFF,
0xFF,0xFF,0xFF,0xFF,0xFF,0xFF,0xFF,0xFF,0xFF,0xFF,0xFF,0xFF,0xFF,0xFF,0xFF,0xFF,
0xFF,0xFF,0x7F,0x7F,0x3F,0xBF,0xBF,0xDF,0xDF,0x5F,0x6F,0x6F,0x6F,0xAF,0xAF,0xB7,
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0xFF,0xFF,0xFF,0xFF,0xFF,0xFF,0xFF,0xFF,0xFF,0xFF,0xFF,0xFF,0xFF,0xFF,0xFF,0xFF,};

void string_down(uint8_t *data,int8_t byte)
{
		uint8_t i;
		uint16_t code_h[8] = {0,0,0,0,0,0,0,0};

    for(i=0;i<8;i++) {
			code_h[i] = ((code_h[i]|data[i+8])<<8)|data[i];
      if(byte>=0)
				code_h[i] = code_h[i]<<byte;
      else
			{
;
				code_h[i] = code_h[i]>>byte;
			}
			data[i]   =  code_h[i];
			data[i+8] =  code_h[i]>>8;

			code_h[i] = 0x0000;
		}
}

//在指定位置显示字符串  style:是否反白
void DispString(uint8_t hx,uint8_t hy,char *str,uint8_t style)
{
 
  uint8_t i,len,c1,c2;
  uint8_t code[32];
  uint8_t x,y;
  uint16_t gbcode;
  uint32_t gbaddr;
  //NeedRefresh=1;//需要刷新显示;
  len=strlen(str);
  if(len>64) len = 64;
  x=hx;
  y=hy; 
  for(i=0;i<len;i++)
  {

    if(str[i] < 0x80)
    {
			c1=str[i];
			gbcode=c1;
			gbaddr=GB2312addr(gbcode);
			ReadGTDot(gbaddr,code,16);
      string_down(code,2);
			Display(x,y,0,code,style);
			x=x+8;
			if(x>=128) { 
				y+=16;
				x=0;
			}
    }
    else
    {
			 c1=str[i];
			 i++;
			 c2=str[i];
			 gbcode=c1*256+c2;
			 gbaddr=GB2312addr(gbcode);
			 ReadGTDot(gbaddr,code,32);
			 Display(x,y,1,code,style);     
			 x=x+16;
			 if(x>=128) { 
				y+=16;
				x=0;
			}
    }
  };
}
//在某一个坐标显示一个字
void Display(uint8_t hx,uint8_t hy,uint8_t charstyle,uint8_t *data,uint8_t style)
{
   uint8_t y,i,j,m,n;
   uint8_t x0,x1;

   hx = hx+4;

   if(charstyle==0)
     j=8;
   else
     j=16;
   n=0;  
   for(i=0;i<2;i++)
   {
//		y=hy*2;
    y=hy;
		y=y&0x0f;
		y=0xb0|y;
		y=y+i;
		x0=(hx>>4)&0x0f;
		x0=0x10|x0;
		x1=hx&0x0f;
		Write_Command(y);
		Write_Command(x0);
		Write_Command(x1);
		 for(m=0;m<j;m++)   
		  {
			if(style)
			  Write_Data(~data[n]);
			else
			  Write_Data(data[n]);
			n++;   
		  }
   }    
}
//在某一个坐标显示一个字
//hx1,5
void Display_mid(uint8_t hx,uint8_t hy,uint8_t charstyle,uint8_t *data,uint8_t style)
{
   uint8_t y,i,j,m,n;
   uint8_t x0,x1;

   hx = hx+4;
   
   if(charstyle==0)
     j=8;
   else
     j=16;
   n=0;  
   for(i=0;i<2;i++)
   {
		y=hy;
		y=y&0x0f;
		y=0xb0|y;
		y=y+i;
		x0=(hx>>4)&0x0f;
		x0=0x10|x0;
		x1=hx&0x0f;
		Write_Command(y);
		Write_Command(x0);
		Write_Command(x1);
		 for(m=0;m<j;m++)   
		  {
			if(style)
			  Write_Data(~data[n]);
			else
			  Write_Data(data[n]);
			n++;   
		  }
   }  
}
void ClearScreen(void)
{
	 uint8_t i,j,m;
	 m=0xb0;
	 for(i=0;i<8;i++)
	{
			Write_Command(m);
			Write_Command(0x10);
			Write_Command(0x00);
			for(j=0;j<132;j++)
			{    
					Write_Data(0);
			}
			m++;
	 }
}
uint8_t show_data = 0;
void Lcd_Dot(uint8_t hx,uint8_t hy,uint8_t style)
{
		uint8_t x0,x1,pag,lin;

    hx = hx + 4;
    pag = hy/8;
		lin = hy%8;
   
    show_data = (0x01<<lin)|show_data;

    if(style)  show_data = ~show_data;
 
		hy=0xb0|pag;
		x0=(hx>>4)&0x0f;
		x0=0x10|x0;
		x1=hx&0x0f;

		Write_Command(hy);
		Write_Command(x0);
		Write_Command(x1);
		
		Write_Data(show_data);
}
//画线(根据指定坐标画直线)
void DisplayLine(uint8_t sx,uint8_t sy, uint8_t ex,uint8_t ey ,uint8_t style)
{
	 uint8_t dy,i;

	 dy = ey-sy;
	 
	 if(dy == 0){
		 for(i=sx;i<ex;i++){
			 Lcd_Dot(i,ey,style);
		 }		
	 }
	 else{
      for(i=sy;i<ey;i++){
			 Lcd_Dot(ex,i,style);
			}
	 }
	 show_data = 0;
}
void Lcd_Test(void)
{
	 uint8_t i,j;
	 for(i=0;i<128;i++){
		 for(j=0;j<64;j++){
			 Lcd_Dot(i,j,0);
			 delay_ms(100);
		 }
	 }
}

void Display_Image(uint8_t page[])
{
	 uint8_t i,j,m;
	 m=0xb0;

	 for(i=0;i<8;i++)
	{
			Write_Command(m);
			Write_Command(0x10);
			Write_Command(0x04);
			for(j=0;j<128;j++)
			{    
					Write_Data(page[(i*128)+j]);
			}
			m++;
	 }
}

void Write_Command(uint8_t command)
{
  uint8_t i,j;
  LCD_CS = 0;
  LCD_A0 = 0;
//  delay_us(1);
   j=0x80;
  for(i=0;i<8;i++)
  {
    LCD_SCK = 0;
    if(command&j)
    {
      LCD_SI = 1;
    }
    else
    {
      LCD_SI = 0;
    }
//    delay_us(1);
    LCD_SCK = 1;
    j=j>>1;
  }
  LCD_CS = 1;
}

void RefreshScreen(void)//刷新屏幕显示
{
  //初始化频
  Lcd_Set();
  ClearScreen(); //清屏
  TimeKey();
  
}
void Write_Data(uint8_t data1)
{
   uint8_t i,j;
   j=0x80;
   LCD_CS = 0;
   LCD_A0 = 1;
//   delay_us(1);
   for(i=0;i<8;i++)   
	 {
		 LCD_SCK = 0;
		 if(data1&j)
		 {
			 LCD_SI = 1;
		 
		 }
		 else
		 {
			 LCD_SI = 0;
		 }
//		 delay_us(1);
		 LCD_SCK = 1;
		 j=j>>1;
	 }
   LCD_CS = 1;  
}
void Read_Data(uint8_t data1)
{
   uint8_t i,j;
   j=0x80;
   LCD_CS = 0;
   LCD_A0 = 1;
//   delay_us(1);
   for(i=0;i<8;i++)   
	 {
		 LCD_SCK = 0;
		 if(data1&j)
		 {
			 LCD_SI = 1;
		 
		 }
		 else
		 {
			 LCD_SI = 0;
		 }
//		 delay_us(1);
		 LCD_SCK = 1;
		 j=j>>1;
	 }
   LCD_CS = 1;  
}
void Set_column_addr(uint8_t add)
{
   uint8_t temp;
   temp=add;
   add=add>>4;
   add=add&0x0f;
   add=add|0x10;
   Write_Command(add);
   add=temp;
   add=add&0x0f;
   Write_Command(add);

}
void Set_row_addr(uint8_t row)
{
    row=row&0x0f;
    row=row|0x0b0;
    Write_Command(row);
}
void Lcd_Set(void)
{
   LCD_RESET = 0;
   delay_ms(100);
   LCD_RESET = 1;
   delay_ms(100);
	 Write_Command(0xE2);          //Software Reset
	 Write_Command(0xA2);          //Set Bias        0xA2   1/7 duty
	 Write_Command(0xA1);          //Segment Direction Select ,bit0=1,reverse;=0,normal;
	 Write_Command(0xC0);          //Common Direction Select,bit3=1,reverse direction;=0,normal;
	 Write_Command(0xAC);  
	 Write_Command(0xA6);          //bit0=0,Normal/bit0=1,Reverse Display  
	 Write_Command(0xA4);
	 Write_Command(0x2C);          //Power Control Set 
	 delay_ms(300); 
	 Write_Command(0x2E);          //Power Control Set 
	 delay_ms(300); 
	 Write_Command(0x2F);          //Power Control Set 
	 delay_ms(300); 
	 Write_Command(0x24);          //set ra/rb 0x25
	
	 Write_Command(0x81);          //Set EV  
	 Write_Command(Contrast);			 //设置对比度  
	
	 Write_Command(0x2f);          //29
	 Write_Command(0xD5);           
	 Write_Command(0x00);          
	 Write_Command(0xD2);           
	 Write_Command(0x00);       
	 Write_Command(0x40);          //Set Display Start Line     0
	 Write_Command(0xb0);       
	 Write_Command(0x10);       
	 Write_Command(0x00);          //Set Booster 4X
	 Write_Command(0xAF);          //Display ON
   ClearScreen();
}
void Myui_Init(void)
{
	GPIO_InitTypeDef  GPIO_InitStructure; 
	RCC_APB2PeriphClockCmd(RCC_APB2Periph_GPIOA,ENABLE);
	
	GPIO_InitStructure.GPIO_Pin = GPIO_Pin_1|GPIO_Pin_4|GPIO_Pin_5|GPIO_Pin_6|GPIO_Pin_7;	 
 	GPIO_InitStructure.GPIO_Mode = GPIO_Mode_Out_PP; 		 
	GPIO_InitStructure.GPIO_Speed = GPIO_Speed_50MHz;
 	GPIO_Init(GPIOA, &GPIO_InitStructure);

	GPIO_SetBits(GPIOA,GPIO_Pin_1|GPIO_Pin_4|GPIO_Pin_5|GPIO_Pin_6|GPIO_Pin_7);
	
	Lcd_Set();
}

void set_Contrast(uint8_t contrast)
{
 	 Write_Command(0x81);          //Set EV  
	 Write_Command(contrast);			 //设置对比度  
}

void Display_Clear(uint8_t data1,uint8_t data2)
{
	 uint8_t i,j,m;
	 m=0xb0;
	 for(i=0;i<1;i++)
	{
		Write_Command(m);
		Write_Command(0x10);
		Write_Command(0xff);
		for(j=0;j<50;j++)
		 {    
				Write_Data(data1);
		 }
		m++;
	 }
}

uint32_t  GB2312addr(uint16_t GBcode) //通过内码找字库地址
{
  uint32_t temp=0;
  uint16_t code;
  uint8_t  c1,c2;
  code=GBcode;
  c1=code>>8;
  c2=code;
  		//ascii  半角字符
		if(code<0x80)
		{

       if( code < ' ' )
				code = ' ';
			 temp=code-' ';	
			 temp = temp*16 + GBEX0816ZF_ADDR;
		}
		else
		{
		 if(c1>=0xA1 && c1 <= 0xAB && c2>=0xa1)
		  {
		  	temp = (c1 - 0xA1) * 94 + (c2 - 0xA1);
		    temp=temp *32 + CUTS1516ZF_ADDR;
		  }
		 else
		  {
		    temp= (c1 - 0xB0) * 94 + (c2 - 0xA1);
		    temp = temp*32 + JFLS1516HZ_ADDR;
		  } 
		
		}
  return temp;
  
}
void ByteHexToStr(uint8_t Hex,char Str[])
{
	char	ddl,ddh;

	ddh = 48 + Hex / 16;
	ddl = 48 + Hex % 16;
	if (ddh > 57) ddh = ddh + 7;
	if (ddl > 57) ddl = ddl + 7;
	Str[0] = ddh;
	Str[1] = ddl;

	Str[2] = '\0';
}
void HexToStr(uint8_t Hex[],char Str[] , uint8_t len)
{
	char	ddl,ddh;
	uint8_t i;

	for (i=0; i<len; i++)
	{
		ddh = 48 + Hex[i] / 16;
		ddl = 48 + Hex[i] % 16;
		if (ddh > 57) ddh = ddh + 7;
		if (ddl > 57) ddl = ddl + 7;
		Str[i*2] = ddh;
		Str[i*2+1] = ddl;
	}
	Str[len*2] = '\0';

}
